## components/jaxcore-storage/Kconfig
```kconfig
menu "Jaxcore fixed SD-NAND storage"

config JAXCORE_STORAGE_SDMMC
    bool "Mount onboard SD-NAND over SDMMC"
    depends on IDF_TARGET_ESP32S31 && DOOM_WAD_FILESYSTEM
    default y
    help
        Use SDMMC Slot 0, 4-bit, 3.3 V on GPIO20-25 from the hardware
        handoff. Requires the board's external CMD/DAT pull-ups. No card
        detect, UHS, internal SD power control, or automatic formatting.

config JAXCORE_STORAGE_MAX_FREQ_KHZ
    int "Maximum SDMMC bus frequency (kHz)"
    depends on JAXCORE_STORAGE_SDMMC
    range 400 20000
    default 10000
    help
        Start at a conservative 10 MHz ceiling; protocol probing starts
        at 400 kHz. Raise only after validation on the fabricated board.

endmenu
```

## sdkconfig.defaults
```kconfig
# S31 compile/link and diagnostics profile. Peripheral drivers are still pending.
CONFIG_IDF_TARGET="esp32s31"
CONFIG_ESPTOOLPY_FLASHSIZE_16MB=y
CONFIG_PARTITION_TABLE_CUSTOM=y
CONFIG_PARTITION_TABLE_CUSTOM_FILENAME="partitions.s31.csv"
CONFIG_SPIRAM=y
CONFIG_SPIRAM_BOOT_INIT=y
CONFIG_SPIRAM_MODE_OCT=y
CONFIG_SPIRAM_SPEED_100M=y
CONFIG_SPIRAM_USE_MALLOC=y
CONFIG_SPIRAM_MALLOC_ALWAYSINTERNAL=4096
CONFIG_SPIRAM_MALLOC_RESERVE_INTERNAL=65536
CONFIG_SPIRAM_MEMTEST=y
CONFIG_DOOM_WAD_FILESYSTEM=y
CONFIG_DOOM_WAD_ROOT="/sdcard/doom"
CONFIG_DOOM_AUDIO_STEREO=y
# CONFIG_DOOM_DISPLAY_SPI is not set
# CONFIG_DOOM_AUDIO_I2S is not set
# CONFIG_DOOM_LEGACY_INPUT is not set
# CONFIG_BT_ENABLED is not set
# CONFIG_HW_PSX_ENA is not set
CONFIG_HW_CUSTOM=y
CONFIG_FREERTOS_HZ=1000
CONFIG_COMPILER_OPTIMIZATION_PERF=y
```
